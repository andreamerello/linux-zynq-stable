## Documentation/devicetree/bindings/display/opencores,ocfb.txt
```
OpenCores VGA/LCD controller

Required properties:
- compatible: "opencores,ocfb"
- reg: Physical base address and length of the controller's registers.
- clocks: Must contain an entry for the pixelclock generator.
  See ../clocks/clock-bindings.txt for details.

Required sub-nodes:
- port: the connection to a bridge chip.  The connection is modelled
  using the OF graph bindings specified in
  Documentation/devicetree/bindings/graph.txt.

Example:

ocdrm@43c10000 {
	compatible = "opencores,ocfb";
	reg = <0x43c10000 0x10000>;
	clocks = <&pix_clock>;
	port {
		rgb_out: endpoint {
			remote-endpoint = <&bridge_in>;
		};
	};

};
```

## Documentation/devicetree/bindings/hwmon/stts751.txt
```
* STTS751 thermometer.

Required node properties:
- compatible: "st,stts751"
- reg: I2C bus address of the device

Optional properties:
- has-therm: specifies that the "therm" pin is wired
- has-event: specifies that the "event" pin is wired
- smbus-timeout-disable: when set, the smbus timeout function will be disabled

Example stts751 node:

temp-sensor {
	compatible = "st,stts751";
	reg = <0x48>;
	has-therm;
	has-event;
}
```

## Documentation/devicetree/bindings/i2c/i2c-smbus.txt
```
* i2c-smbus extensions

Required Properties:
  - compatible: Must contain "smbus_alert"
  - interrupts: The irq line for smbus ALERT signal
  - reg: I2C slave address. Set to 0x0C (alert response address).

Note: The i2c-smbus module registers itself as a slave I2C device. Whenever
a smbus controller directly support smbus extensions (and its driver supports
this), there is no need to add anything special to the DT. Otherwise, for using
i2c-smbus with any smbus-extensions-unaware I2C controllers, you need to
route the smbus ALARM signal to an extra IRQ line, thus you need to describe
this in the DT.

Example:
	alert@0x0C {
		reg = <0x0C>;
		compatible = "smbus_alert";
		interrupts = <0 36 IRQ_TYPE_LEVEL_LOW>;
	};
```

## Documentation/devicetree/bindings/sound/adi,ssm2518.txt
```
Analog Devices SSM2518 audio setup

Required properties:

 - compatible:		Should contain "digilent,ssm2518-sound"
 - audio-codec:		phandle for the ssm2518 codec
 - cpu-dai:         phandle for i2c controller of ssm2518 chip

Examples:

    cer_sound {
        compatible = "digilent,ssm2518-sound";
        audio-codec = <&ssm2518>;
        cpu-dai = <&axi_i2s_adi_0>;
    };
```

## drivers/gpu/drm/iitdgi/Kconfig
```kconfig
config DRM_IITDGI
	tristate "DRM Support for IIT DGI video core"
	depends on DRM
	default	n
	select DRM_KMS_HELPER
	select DRM_KMS_CMA_HELPER
	select VT_HW_CONSOLE_BINDING if FRAMEBUFFER_CONSOLE
```

## drivers/gpu/drm/ocdrm/Kconfig
```kconfig
config DRM_OCDRM
	tristate "DRM Support for opencores OCFB"
	depends on DRM
	default	n
	select DRM_KMS_HELPER
	select DRM_KMS_CMA_HELPER
	select VT_HW_CONSOLE_BINDING if FRAMEBUFFER_CONSOLE
```

## sound/soc/iit/Kconfig
```kconfig
config SND_SOC_IIT_GLA
	tristate "Board sound support for Glassense"
	depends on SND_SOC_ADI
	select SND_SOC_ADI_AXI_I2S
	help
      Audio support Glassense.

config SND_SOC_IIT_SSM2518
	tristate "Board sound support ssm2518"
	depends on SND_SOC_ADI
	depends on I2C
	select SND_SOC_ADI_AXI_I2S
	select SND_SOC_SSM2518
	help
      Audio support for various reference designs by Analog Devices.
```
